## src/modules/fault_manager/Kconfig
```kconfig
menuconfig MODULES_FAULT_MANAGER
    bool "fault_manager"
    default n
    ---help---
        Enable support for the FAULT fault manager infrastructure module.
```
